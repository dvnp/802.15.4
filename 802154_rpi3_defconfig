## 802154_rpi3_defconfig
```kconfig
BR2_JLEVEL=4

BR2_LINUX_KERNEL_CUSTOM_TARBALL=y
# BR2_LINUX_KERNEL_CUSTOM_GIT is not set
BR2_LINUX_KERNEL_CUSTOM_TARBALL_LOCATION="https://github.com/raspberrypi/linux/archive/raspberrypi-kernel_1.20170703-2.tar.gz"
BR2_LINUX_KERNEL_VERSION="custom"
# BR2_LINUX_KERNEL_CUSTOM_REPO_URL is not set
# BR2_LINUX_KERNEL_CUSTOM_REPO_VERSION is not set

BR2_TARGET_GENERIC_ISSUE="Welcome to 802.15.4 RPi3 Gateway"
BR2_TARGET_GENERIC_ROOT_PASSWD="root"

BR2_ROOTFS_OVERLAY="board/raspberrypi3/rootfs_overlay"
BR2_ROOTFS_POST_BUILD_SCRIPT="board/raspberrypi3/post-build.sh"
BR2_ROOTFS_POST_IMAGE_SCRIPT="board/raspberrypi3/post-image-802154.sh board/raspberrypi3/post-image.sh"
BR2_ROOTFS_POST_SCRIPT_ARGS="--add-pi3-miniuart-bt-overlay --add-at86rf233-overlay"

BR2_PACKAGE_LIBTOOL=y

BR2_PACKAGE_RPI_FIRMWARE_INSTALL_DTB_OVERLAYS=y
BR2_PACKAGE_ZLIB=y

BR2_PACKAGE_OPENSSL=y
BR2_PACKAGE_OPENSSL_BIN=y
BR2_PACKAGE_OPENSSL_ENGINES=y

BR2_PACKAGE_LIBNL=y
BR2_PACKAGE_LIBNL_TOOLS=y

BR2_PACKAGE_LIBPCAP=y

BR2_PACKAGE_IPTABLES=y
BR2_PACKAGE_IPTABLES_BPF_NFSYNPROXY=y

BR2_PACKAGE_IPUTILS=y

BR2_PACKAGE_OPENSSH=y

BR2_PACKAGE_WPAN_TOOLS=y

BR2_TARGET_ROOTFS_EXT2_BLOCKS=120000

BR2_LINUX_KERNEL_CONFIG_FRAGMENT_FILES="board/raspberrypi/802154_linux_defconfig"
```
